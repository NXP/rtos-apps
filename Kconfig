## Kconfig
```kconfig
# Copyright 2025-2026 NXP
#
# SPDX-License-Identifier: BSD-3-Clause

menu "RTOS Application components"
  rsource "./log/Kconfig"
  rsource "./stats/Kconfig"
  rsource "./audio/Kconfig"
  rsource "./tsn/Kconfig"
  rsource "./async/Kconfig"
  rsource "./shell/Kconfig"
endmenu
```

## Kconfig.mcux
```kconfig
# Copyright 2025-2026 NXP
#
# SPDX-License-Identifier: BSD-3-Clause

menu "RTOS Application components"
  rsource "./log/Kconfig.mcux"
  rsource "./stats/Kconfig.mcux"
  rsource "./audio/Kconfig.mcux"
  rsource "./tsn/Kconfig.mcux"
  rsource "./async/Kconfig.mcux"
  rsource "./shell/Kconfig.mcux"
  rsource "./storage/Kconfig.mcux"
endmenu
```

## Kconfig.z
```kconfig
# Copyright 2026 NXP
#
# SPDX-License-Identifier: BSD-3-Clause
#

menuconfig RTOS_APPS
	bool "RTOS Apps"
	help
	  Enable the RTOS Apps library. Individual components are selected
	  independently below.

if RTOS_APPS

config RTOS_APPS_ASYNC
	bool "Asynchronous processing"
	default n
	help
	  Enable the asynchronous processing helper (async.c). Provides a
	  lightweight deferred-work mechanism used by the TSN and audio
	  pipelines.

menuconfig RTOS_APPS_LOG
	bool "Logging"
	default n
	help
	  Enable the logging component (log.c). Provides a thin wrapper
	  around debug output with optional timestamps and a component
	  name label.

if RTOS_APPS_LOG

rsource "log/Kconfig"

endif # RTOS_APPS_LOG

config RTOS_APPS_STATS
	bool "Statistics"
	default n
	help
	  Enable the statistics helper (stats.c). Provides lightweight
	  runtime counters and latency measurements for application tasks.

config RTOS_APPS_AUDIO
	bool "Audio pipeline"
	default n
	select RTOS_APPS_LOG
	select RTOS_APPS_STATS
	help
	  Enable the audio pipeline component. Provides a multi-element
	  pipeline (SAI source/sink, routing, DTMF, sine generator) for
	  AVB/non-AVB audio applications.

config RTOS_APPS_AUDIO_CTRL
	bool "Audio pipeline control headers"
	default n
	help
	  Include audio pipeline control headers.

menuconfig RTOS_APPS_SHELL
	bool "Shell commands"
	default n
	help
	  Enable the RTOS Apps shell command set. Provides runtime
	  inspection and configuration of TSN/AVB parameters via the
	  Zephyr shell subsystem.

if RTOS_APPS_SHELL

rsource "shell/Kconfig"

config RTOS_APPS_TSN_BRIDGE
	bool "TSN bridge shell commands"
	help
	  Include shell commands for TSN bridge management: FDB, FRER, HSR,
	  PSFP, stream identification, and VLAN configuration.
	  Enable this option only on boards that include a TSN bridge.

endif # RTOS_APPS_SHELL

config RTOS_APPS_STORAGE
	bool "Storage"
	default n
	help
	  Enable the storage component (storage_common.c). Provides
	  persistent read/write access to application configuration
	  and calibration data.

menuconfig RTOS_APPS_TSN
	bool "TSN endpoint"
	default n
	select RTOS_APPS_ASYNC
	select RTOS_APPS_LOG
	select RTOS_APPS_STATS
	help
	  Enable the TSN endpoint component. Provides the cyclic task,
	  alarm task, TSN pipeline configuration, and monitoring
	  statistics for IEEE 802.1 TSN endpoint applications.

endif # RTOS_APPS
```

## async/Kconfig
```kconfig
# Copyright 2025 NXP
#
# SPDX-License-Identifier: BSD-3-Clause

config MCUX_COMPONENT_component.rtos_apps.async
    bool "Asynchronous processing component"
    default n

    if MCUX_COMPONENT_component.rtos-apps.async
    endif
```

## audio/Kconfig
```kconfig
config MCUX_COMPONENT_component.rtos_apps.audio
    bool "Audio Pipeline component"
    default n
    select MCUX_COMPONENT_driver.sai
    select MCUX_COMPONENT_component.rtos_apps.log
    select MCUX_COMPONENT_component.rtos_apps.stats

    if MCUX_COMPONENT_component.rtos_apps.audio

      config MCUX_COMPONENT_component.rtos_apps.audio.genavb
          bool "Audio AVB support"
          default n

      config MCUX_COMPONENT_component.rtos_apps.audio.pll
          bool "Audio PLL support"
          default n

      config RTOS_APPS_AUDIO_GENAVB_ENABLE
          bool
          default y if MCUX_COMPONENT_component.rtos_apps.audio.genavb

    endif
```

## log/Kconfig
```kconfig
# Copyright 2025-2026 NXP
#
# SPDX-License-Identifier: BSD-3-Clause

# Note: Do not define default values as it might be defined on the
#       MCUXpresso Kconfig counterpart.

config RTOS_APPS_LOG_TIMESTAMP
	bool "Log timestamp"
	help
	  Prefix each log message with a hardware timestamp.

config RTOS_APPS_LOG_STR
	string "Log component name"
	help
	  Provides a string name for logging.
	  Macro value is in quotes (this sentence is parsed by MCUXpresso)
```

## log/Kconfig.mcux
```kconfig
# Copyright 2025-2026 NXP
#
# SPDX-License-Identifier: BSD-3-Clause

config MCUX_COMPONENT_component.rtos_apps.log
    bool "Logging component"
    default n

    if MCUX_COMPONENT_component.rtos_apps.log
        rsource "./Kconfig"
    endif
```

## shell/Kconfig
```kconfig
# Copyright 2026 NXP
#
# SPDX-License-Identifier: BSD-3-Clause

# Note: Do not define default values as it might be defined on the
#       MCUXpresso Kconfig counterpart.

config RTOS_APPS_FP
	bool "Frame Preemption (FP) shell commands"
	help
	  Include the Frame Preemption (802.3br) shell command set.
	  Allows runtime inspection and configuration of FP parameters.

config RTOS_APPS_QBV
	bool "Qbv (802.1Qbv) shell commands"
	help
	  Include the Time-Aware Shaper (802.1Qbv) shell command set.
	  Allows runtime inspection and configuration of gate control lists.
```

## shell/Kconfig.mcux
```kconfig
# Copyright 2026 NXP
#
# SPDX-License-Identifier: BSD-3-Clause

config MCUX_COMPONENT_component.rtos_apps.shell
    bool "Shell component"
    default n

    if MCUX_COMPONENT_component.rtos_apps.shell

        rsource "./Kconfig"

        config MCUX_COMPONENT_component.rtos_apps.shell.tsn_bridge
            bool "Use TSN components"
            default n

        config MCUX_COMPONENT_component.rtos_apps.shell.fp
            bool "Use Shell fp components"
            default n

        config MCUX_COMPONENT_component.rtos_apps.shell.qbv
            bool "Use Shell qbv components"
            default n

        config RTOS_APPS_FP
            default y if MCUX_COMPONENT_component.rtos_apps.shell.fp

        config RTOS_APPS_QBV
            default y if MCUX_COMPONENT_component.rtos_apps.shell.qbv
    endif
```

## stats/Kconfig
```kconfig
config MCUX_COMPONENT_component.rtos_apps.stats
    bool "Statistics component"
    default n

    if MCUX_COMPONENT_component.rtos_apps.stats
    endif
```

## stats/Kconfig.mcux
```kconfig
# Copyright 2025 NXP
#
# SPDX-License-Identifier: BSD-3-Clause

config MCUX_COMPONENT_component.rtos_apps.stats
    bool "Statistics component"
    default n

    if MCUX_COMPONENT_component.rtos_apps.stats
    endif
```

## storage/Kconfig
```kconfig
# Copyright 2026 NXP
#
# SPDX-License-Identifier: BSD-3-Clause

config MCUX_COMPONENT_component.rtos_apps.storage_common
    bool "Storage component"
    default n

    if MCUX_COMPONENT_component.rtos_apps.storage_common

        config RTOS_APPS_STORAGE
        bool
        default y if MCUX_COMPONENT_component.rtos_apps.storage_common
    endif
```

## tsn/Kconfig
```kconfig
config MCUX_COMPONENT_component.rtos_apps.tsn
    bool "TSN Endpoint component"
    default n
    select MCUX_COMPONENT_component.rtos_apps.async
    select MCUX_COMPONENT_component.rtos_apps.log
    select MCUX_COMPONENT_component.rtos_apps.stats

    if MCUX_COMPONENT_component.rtos_apps.tsn

        config MCUX_COMPONENT_component.rtos_apps.tsn.lwip
            bool "Use IP stack"
            default n
            select MCUX_COMPONENT_middleware.lwip
            select MCUX_COMPONENT_middleware.lwip.sys_arch.dynamic
            select MCUX_COMPONENT_middleware.lwip.apps.lwiperf
            select MCUX_COMPONENT_middleware.lwip.empty_ethernetif

        config MCUX_COMPONENT_component.rtos_apps.tsn.motor.controller
            bool "Motor Controller support"
            default n
            select MCUX_COMPONENT_component.rtos_apps.tsn.user_button

        config MCUX_COMPONENT_component.rtos_apps.tsn.motor.iodevice
            bool "Motor IO-Device support"
            default n
            select MCUX_COMPONENT_component.rtos_apps.tsn.user_button

        config MCUX_COMPONENT_component.rtos_apps.tsn.user_button
            bool "User button support"
            default n

        config RTOS_APPS_LWIP
            bool
            default y if MCUX_COMPONENT_component.rtos_apps.tsn.lwip

        config RTOS_APPS_USER_BUTTON
            bool
            default y if MCUX_COMPONENT_component.rtos_apps.tsn.user_button

        config RTOS_APPS_MOTOR_CONTROLLER
            bool
            default y if MCUX_COMPONENT_component.rtos_apps.tsn.motor.controller

        config RTOS_APPS_MOTOR_IO_DEVICE
            bool
            default y if MCUX_COMPONENT_component.rtos_apps.tsn.motor.iodevice
    endif

config MCUX_COMPONENT_component.rtos_apps.tsn_headers
    bool "TSN headers"
    default n
    help
        Minimal necessary headers to be able to compile AVB/TSN applications
```
